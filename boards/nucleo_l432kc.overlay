/*
 * SPDX-License-Identifier: Apache-2.0
 *
 * Copyright (c) 2020 Libre Solar Technologies GmbH
 */

/ {
	zephyr,user {
		/* adjust channel number according to pinmux in board.dts */
		io-channels = <&adc1 12>;
	};
    
};

&adc1{
    status="okay";
    pinctrl-0=<&adc1_in5_pa0>;
    pinctrl-names = "default";
};
